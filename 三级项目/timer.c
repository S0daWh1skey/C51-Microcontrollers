#include<reg52.h>
#include"display.h"
#include"timer.h"
/*------------------------------------------------
                    定时器初始化子程序
------------------------------------------------*/
void Init_Timer0(void)
{
 TMOD |= 0x01;	  //使用模式1，16位定时器，使用"|"符号可以在使用多个定时器时不受影响		     
 //TH0=0x00;	      //给定初值
 //TL0=0x00;
 EA=1;            //总中断打开
 ET0=1;           //定时器中断打开
 TR0=1;           //定时器开关打开
}
/*------------------------------------------------
                 定时器中断子程序
------------------------------------------------*/
void Timer0_isr(void) interrupt 1 
{
 static unsigned int num,i; 
 TH0=(65536-2000)/256;//重新赋值 2ms 定时器初始值是63536 将数字赋给高八位
 TL0=(65536-2000)%256;//将数字赋给低八位  //两毫秒定时器溢出 中断
 
 Display(0,8);       // 调用数码管扫描
 i++;
 if(i==10)          //20ms更新一次 FPS=50
    {
	i=0;//重置i
	UpdateTimeFlag=1; //更新时间志位置1 开始更新八段数码管上的数字 全局变量
	}
if(Time_seted_flag==1){
 num++;
 if(num==500)        //大致1s
   {
    num=0;
	second++;
	if(second==60)  //秒到60，分钟加1
	 {
	  second=0;	  
	  minute++;
	  if(minute==60)//分钟到60，小时加1
	    {
		 minute=0;
		 hour++;
		 if(hour==24)//小时到24，回零
		   hour=0;
		}
	  }
	}
  }
}
